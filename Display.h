// Based on: https://github.com/adafruit/Adafruit_SSD1306/blob/master/examples/ssd1306_128x64_i2c/ssd1306_128x64_i2c.ino
// Image conversion: https://javl.github.io/image2cpp/
#include <SPI.h>
#include <Wire.h>
#include <Adafruit_GFX.h>     // Adafruit SSD1306
#include <Adafruit_SSD1306.h> // Adafruit GFX Library

#define SCREEN_WIDTH 128 // OLED display width, in pixels
#define SCREEN_HEIGHT 64 // OLED display height, in pixels

#define PIN_DISPLAY_SDA 20 // Nano: A4, MEGA: 20, Leonardo: 20
#define PIN_DISPLAY_SCL 21 // Nano: A5, MEGA: 21, Leonardo: 21

// Declaration for an SSD1306 display connected to I2C (SDA, SCL pins)
#define OLED_RESET     -1 // Reset pin # (or -1 if sharing Arduino reset pin)
Adafruit_SSD1306 display(SCREEN_WIDTH, SCREEN_HEIGHT, &Wire, OLED_RESET);

const unsigned char logo_bmp_40x64 [] PROGMEM = {
  // 'BV_Logo_40x64, 40x64px
  0xff, 0xff, 0xff, 0xff, 0xff, 0xff, 0xff, 0xff, 0xff, 0xff, 0xff, 0xff, 0xff, 0xff, 0xff, 0xe0, 
  0x00, 0x00, 0x00, 0x07, 0xe0, 0x00, 0x00, 0x00, 0x07, 0xe0, 0x40, 0x00, 0x40, 0x87, 0xe0, 0x3f, 
  0xf8, 0x7f, 0x87, 0xe0, 0x3f, 0xfc, 0x7f, 0x87, 0xe2, 0x1f, 0xfc, 0x7f, 0x87, 0xe2, 0x1f, 0xfe, 
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  0x07, 0xe0, 0x00, 0x00, 0x00, 0x07, 0xff, 0xff, 0xff, 0xff, 0xff, 0xff, 0xff, 0xff, 0xff, 0xff
};

void drawLogo40x64_center_center(void) {
  display.drawBitmap(
    (display.width() - 40 ) / 2,
    (display.height() - 64) / 2,
    logo_bmp_40x64, 40, 64, 1);
}

const unsigned char logo_bmp_30x48 [] PROGMEM = {
  // 'BV_Logo_30x48, 30x48px
  0xff, 0xff, 0xff, 0xfc, 0xff, 0xff, 0xff, 0xfc, 0xc0, 0x00, 0x00, 0x0c, 0xc0, 0x00, 0x00, 0x0c, 
  0xc1, 0xff, 0x1f, 0x8c, 0xc1, 0xff, 0x3f, 0x8c, 0xc8, 0xff, 0xbf, 0x8c, 0xc8, 0xff, 0xbf, 0x8c, 
  0xcc, 0x7f, 0xff, 0x8c, 0xcc, 0x3f, 0xff, 0x8c, 0xce, 0x3f, 0xff, 0x8c, 0xce, 0x3f, 0xff, 0x8c, 
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  0xc0, 0x00, 0x00, 0x0c, 0xc0, 0x00, 0x00, 0x0c, 0xff, 0xff, 0xff, 0xfc, 0xff, 0xff, 0xff, 0xfc
};

void drawLogo30x48_bottom_left(void) {
  display.drawBitmap(
    0,
    16,
    logo_bmp_30x48, 30, 48, 1);
}

void drawLogo30x48_bottom_center(void) {
  display.drawBitmap(
    (display.width() - 30) / 2,
    16,
    logo_bmp_30x48, 30, 48, 1);
}

void DrawUrl()
{
  String str = "BeVollbart.com";
  int cntChar = str.length();
  const int scaleTxt = 2;
  display.setTextSize(scaleTxt);
  display.setTextColor(WHITE);
  display.setCursor(0, 0);
  display.print(str);
}

void DrawOctave(int octave)
{
  int cntChar = octave < 0 ? 2 : 1;
  const int scaleTxt = 7;
  display.setTextSize(scaleTxt);
  display.setTextColor(WHITE);
  display.setCursor((int)SCREEN_WIDTH - cntChar * scaleTxt * 6, (int)SCREEN_HEIGHT / 4);
  display.print(octave);
}

void DrawHold()
{
  const int cntChar = 4;
  const int scaleTxt = 2;
  display.setTextSize(scaleTxt);
  display.setTextColor(WHITE);
  display.setCursor((int)SCREEN_WIDTH - cntChar * scaleTxt * 6, 0);
  display.print("HOLD");
}

void DrawChannel(int channel)
{
  String str = "CH";
  str.concat(channel);
  display.setTextSize(1);
  display.setTextColor(WHITE);
  display.setCursor(0, 0);
  display.print(str);
}

void DrawMode(bool useUsbMidi)
{
  display.setTextSize(1);
  display.setTextColor(WHITE);
  display.setCursor(0, 8);
  if (useUsbMidi)
    display.print("USB");
  else
    display.print("SERIAL");
}

void setupDisplay()
{
  // SSD1306_SWITCHCAPVCC = generate display voltage from 3.3V internally
  if(!display.begin(SSD1306_SWITCHCAPVCC, 0x3C)) { 
    Serial.println(F("SSD1306 allocation failed"));
    for(;;); // Don't proceed, loop forever
  }
  display.clearDisplay();
  drawLogo40x64_center_center();
  display.display();
  delay(500);
  display.clearDisplay();
  DrawUrl();
  drawLogo30x48_bottom_center();
  display.display();
  delay(1000);
}

int lastOctave = -999;
bool lastIsHold = false;
int lastChannel = -999;
bool lastUseUsbMidi = false;

void loopDisplay(int octave, bool isHold, int channel, bool useUsbMidi)
{
  // Only draw if necessary!
  // This must stay responsive!
  if (octave == lastOctave && isHold == lastIsHold && channel == lastChannel && useUsbMidi == lastUseUsbMidi)
    return;
  
  display.clearDisplay();
  DrawChannel(channel);
  DrawMode(useUsbMidi);
  DrawOctave(octave);
  if (isHold)
    DrawHold();
  drawLogo30x48_bottom_left();
  display.display();

  lastOctave = octave;
  lastIsHold = isHold;
  lastChannel = channel;
  lastUseUsbMidi = useUsbMidi;
}
